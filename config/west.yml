## config/west.yml
```yaml
manifest:
  remotes:
    # zmk official
    - name: zmkfirmware
      url-base: https://github.com/zmkfirmware
    # Prospector module
    #- name: carrefinho
    #  url-base: https://github.com/carrefinho
    # ZMK Dongle Screen
    - name: janpfischer
      url-base: https://github.com/janpfischer
    # ZMK tri-state
    - name: dhruvinsh
      url-base: https://github.com/dhruvinsh
    # RGB Led
    - name: caksoylar
      url-base: https://github.com/caksoylar
    # dongle_screen A
    #- name: englmaxi
    #  url-base: https://github.com/englmaxi
    #- name: tokyo2006
    #  url-base: https://github.com/tokyo2006
    # dongle_screen B
    #- name: inorichi
    #  url-base: https://github.com/inorichi
    # dongle oled
    - name: mctechnology17
      url-base: https://github.com/mctechnology17
  projects:
    - name: zmk
      remote: zmkfirmware
      revision: v0.3
      import: app/west.yml
    #- name: prospector-zmk-module
    #  remote: carrefinho
    #  revision: main
    - name: zmk-tri-state
      remote: dhruvinsh
      revision: main
    - name: zmk-rgbled-widget
      remote: caksoylar
      revision: v0.3
    - name: zmk-dongle-screen
      remote: janpfischer
      revision: main 
    # Both for dongle oled screen    
    #- name: prospector-zmk-module                 # <--- and these
    #  remote: tokyo2006                           # <---
    #  revision: micro_spi2 
    #- name: zmk-dongle-display
    #  remote: englmaxi
    #  revision: v0.3
    # Dongle_screen B
    # ...
    # Dongle Oled
    - name: zmk-oled-adapter
      remote: mctechnology17
      revision: main
  self:
    path: config
```
